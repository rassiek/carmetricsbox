//OLED
#include <Arduino.h>
#include <U8g2lib.h>
#include <Wire.h> //allows communication over i2c devices
#include <avr/pgmspace.h>

//PressureSensorsV
  const int oilPressureInput = A3; //select the analog input pin for the pressure transducer
  const int boostPressureInput = A4; //select the analog input pin for the pressure transducer
  const int pressureZero = 102.4; //analog reading of pressure transducer at 0psi
  const int pressureMax = 921.6; //analog reading of pressure transducer at 100psi
  const int pressuretransducermaxPSI = 100; //psi value of transducer being used
  const int sensorreadDelay = 250; //constant integer to set the sensor read delay in milliseconds
  float oilPressure = 0; //variable to store the value coming from the pressure transducer
  float boostPressure = 0; //variable to store the value coming from the pressure transducer
  float oilPressureValue = 0; //variable to store the converted to Psi value from oilPressure
  float boostPressureValue = 0; //variable to store the converted to Psi value from boostPressure
//END PressureSensorsVars

//BUZZ and Flasher
  const int led = 39 ; //The PWM port for led flasher flash()
  const int buzzer = 38 ;   //The PWM port for Buzzer buzz()
//BUZZ and Flasher

/////////Thresholds warning- flashing , upper - Beeping Used together with the section on Pixel Calculation Below - Some variables of items Gauges section are ////////
////StartThresholds Declaration
  //How to test
  //int warningThreshTrans = -700;   //Change thresholds to low values to cause a false positive
  //int upperThreshTrans = -800;  
  //Gearbox and TransferCase  
    int warningThreshTrans = 70;
    int upperThreshTrans = 80;     
  // Please note Warning Thresholds for EGT, Coolant and Boost - Used together with Variables declared in the section below (upperThresh and LowerThresh) 
  //While variables in this section only affect the beeping and flashing thresholds, the ones below affect the upper and lowe position of the '|' marks in the gauges.    
    int warningThreshCT = 88;
    int warningThreshEGT = 400;
    int warningThreshBST = 16;        
////EndThresholds Declaration 

//OLED Pixel Calculations by Sensor
  //Pixel Range is 25-100 - Based on the screen size
  ////////////////////Oil Ration 1 pixel = 1 psi 
    int numberOfPixels = 75;
    int maxOP = 75;
    int minOP = 0;
    int upperThreshOP = 70; //Pos 95 ie 25+70             //Threhold also used for critical level alerting
    int lowerThreshOP = 15; //Pos 40
    //Calculated from above
    float multiplierOP = pow((maxOP-minOP),-1)*numberOfPixels ;
    float baselineOP = minOP*multiplierOP-25;

  //////////////////////Coolant  Ration 1 pixel = 0.6666 deg
    int maxCT = 127.5;
    int minCT = 15;  
    int upperThreshCT = 95;   //Pos 88                      //Threhold also used for critical level alerting
    int lowerThreshCT = 40;  //Pos  52
    //Calculated from above
    float multiplierCT = pow((maxCT-minCT),-1)*numberOfPixels ;
    float baselineCT = minCT*multiplierCT-25;

  ////////////////////////EGT  Ration 1 pixel = 7 deg
  //EGT  Ration 1 pixel = 10.2 deg
    int maxEGT = 800;
    ////int minEGT = 275;
    int minEGT = 30;
    int upperThreshEGT = 650; //   Pos 86   (650-30) * 10.2 = 60.7843   Add 25 (min pixel in box)  = 85.7843            //Threhold also used for critical level alerting
    //////int lowerThreshEGT = 300;  // Pos 29
    int lowerThreshEGT = 173;  // Pos 40
    //Calculated from above
    float multiplierEGT = pow((maxEGT-minEGT),-1)*numberOfPixels ;
    float baselineEGT = minEGT*multiplierEGT-25;

  ////////////////////////BOOST  1 Pixel = 0.4 psi or 2.5 pixels = 1 PSI
  //BOOST  1 Pixel = 0.2857 psi or 3.5 pixels = 1 PSI
    ////int maxBST = 30;
    int maxBST = 20;
    int minBST = 0;
    int upperThreshBST = 18; // Pos 90.5                     //Threhold also used for critical level alerting
    int lowerThreshBST = 5; // Pos 44
    //Calculated from above
    float multiplierBST = pow((maxBST-minBST),-1)*numberOfPixels ;
    float baselineBST = minBST*multiplierBST-25;

//END OLED Pixel Calculations by Sensor


//Battery Voltage Analog Sensors section
    #define BAT1_ANALOG_PIN A5
    #define BAT2_ANALOG_PIN A6
    // Floats for ADC voltage & Input voltage
    float adc_voltage1 = 0.0;
    float adc_voltage2 = 0.0;
    float in_voltage1 = 0.0;
    float in_voltage2 = 0.0;
    // Floats for resistor values in divider (in ohms)
    float R1 = 30000.0;
    float R2 = 7500.0; 
    // Float for Reference Voltage
    float ref_voltage = 5.0;
    // Integer for ADC value
    int adc_value1 = 0;
    int adc_value2 = 0;
//END Battery Voltage Analog Sensors section




// RTC DS1302
// CONNECTIONS:
// DS1302 CLK/SCLK --> 5  34
// DS1302 DAT/IO --> 4  32
// DS1302 RST/CE --> 2  30
// DS1302 VCC --> 3.3v - 5v
// DS1302 GND --> GND
#include <ThreeWire.h>  
#include <RtcDS1302.h>
//ThreeWire myWire(4,5,2); // IO, SCLK, CE
ThreeWire myWire(32,34,30); // IO, SCLK, CE
RtcDS1302<ThreeWire> Rtc(myWire);
#define countof(a) (sizeof(a) / sizeof(a[0]))
const char data[] = "what time is it";
// END RTC DS1302



//OLED 
  //U8G2_SSD1327_EA_W128128_F_SW_I2C u8g2(U8G2_R0, /* clock=*/ 9, /* data=*/ 8, /* reset=*/ U8X8_PIN_NONE);
  //U8G2_SSD1327_EA_W128128_F_HW_I2C u8g2(U8G2_R0, /* clock=*/ 21, /* data=*/ 20, /* reset=*/ U8X8_PIN_NONE);
  U8G2_SSD1327_MIDAS_128X128_F_HW_I2C u8g2(U8G2_R0, /* clock=*/ 21, /* data=*/ 20, /* reset=*/ U8X8_PIN_NONE);
  //U8G2_SSD1327_EA_W128128_F_HW_I2C u8g2(U8G2_R0, /* clock=*/ 9, /* data=*/ 8, /* reset=*/ U8X8_PIN_NONE);

  // 'Logo', 128x128px
  #define u8g_logo_width 128
  #define u8g_logo_height 118
  
    static const unsigned char frame00[] PROGMEM = {
    // 'Logo', 128x128px
      0x00, 0x00, 0x00, 0x00, 0x00, 0x00, 0x00, 0x00, 0x00, 0x00, 0x00, 0x00, 
      0x00, 0x00, 0x00, 0x00, 0x00, 0x00, 0x00, 0x00, 0x00, 0x00, 0x00, 0x00, 
      0x00, 0x00, 0x00, 0x00, 0x00, 0x00, 0x00, 0x00, 0x00, 0x00, 0x00, 0x00, 
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      0x00, 0x00, 0x00, 0x00, 0x00, 0x00, 0x00, 0x00 };
    
    static const unsigned char frame01[] PROGMEM = {
    
      0x00, 0x00, 0x00, 0x00, 0x00, 0x00, 0x00, 0x00, 0x00, 0x00, 0x00, 0x00, 
      0x00, 0x00, 0x00, 0x00, 0x00, 0x00, 0x00, 0x00, 0x00, 0x00, 0x00, 0x00, 
      0x00, 0x00, 0x00, 0x00, 0x00, 0x00, 0x00, 0x00, 0x00, 0x00, 0x00, 0x00, 
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      0x00, 0x00, 0x00, 0x00, 0x00, 0x00, 0x00, 0x00};
//END OLED

//TP - Senosor used for altitude, pressure and cabin temp
    #include <Wire.h>
    #include <Adafruit_BMP085.h>
    #define seaLevelPressure_hPa 1017.0
    Adafruit_BMP085 bmp;
//ENDTP


//TCMAX6675  - EGT Amplifier
    #include "max6675.h"
    int thermoDO = 4;
    int thermoCS = 5;
    int thermoCLK = 6;
    MAX6675 thermocouple(thermoCLK, thermoCS, thermoDO);
//ENDTCMAX6675

//1W  - All 1 wire DS18B20 (GB, TC, Coolant, Intake Manifold)
    /* Multiple DS18B20 1-Wire digital temperature sensors with Arduino example code. More info: https://www.makerguides.com */
    // Include the required Arduino libraries:
    #include <OneWire.h>
    #include <DallasTemperature.h>
    // Define to which pin of the Arduino the 1-Wire bus is connected:
    #define ONE_WIRE_BUS 7
    // Create a new instance of the oneWire class to communicate with any OneWire device:
    OneWire oneWire(ONE_WIRE_BUS);
    // Pass the oneWire reference to DallasTemperature library:
    DallasTemperature sensors(&oneWire);
    int deviceCount = 0;
    float tempC;
    float tempF;

      // Addresses of the 1 wire temp sensors DS18B20s - Sensor replacement will need to be updated here. 
        uint8_t sensor1[8] = { 0x28, 0xAA, 0xA5, 0xD4, 0x4A, 0x14, 0x01, 0xB1 };
        uint8_t sensor2[8] = { 0x28, 0xC5, 0x7A, 0x79, 0x97, 0x07, 0x03, 0x5F };  //T Transfer Case Temp
        uint8_t sensor3[8] = { 0x28, 0xD5, 0x6E, 0x79, 0x97, 0x08, 0x03, 0x7F };  //
        uint8_t sensor4[8] = { 0x28, 0x2D, 0x10, 0x79, 0x97, 0x07, 0x03, 0x7B };  //T Gear Box Temp
        uint8_t sensor5[8] = { 0x28, 0xE7, 0x6F, 0x79, 0x97, 0x09, 0x03, 0xF5 };  //HT Faulty Head Temp
        uint8_t sensor6[8] = { 0x28, 0x0F, 0x71, 0x79, 0x97, 0x07, 0x03, 0x7F };  //I Intake Manifold Temp
        uint8_t sensor7[8] = { 0x28, 0xFD, 0x86, 0x9F, 0x0D, 0x00, 0x00, 0x1A };  //CT Coolant Temp
      
      //End1W


void setup(void) 

//TCMAX6675 - EGT
{
  Serial.begin(9600);
  Serial2.begin(4800);

  Serial.println("Initialize Thermal Couple EGT Sensor MAX6675");
  // wait for MAX chip to stabilize
  //delay(500);
//ENDTCMAX6675


//OLED
  if (!u8g2.begin()) {
  Serial.println("Unable to Initialize OLED Check Connection");
  }
else 
 {
 Serial.println("Initialized OLED Successfully");
  }

u8g2.clearBuffer();
u8g2.setDrawColor(1);

   draw();


//TP
//{
                                       //Serial.begin(9600);
  if (!bmp.begin()) {
  Serial.println("Unable to Initialize Cabin Pressure and Temp Sensor BMP085 Check Connection");
///////  while (1) {}
  }
else 
 {
 Serial.println("Initialized Cabin Pressure and Temp Sensor BMP085");
  }
//}
//EndTP


//1W
//{
  // Begin serial communication at a baud rate of 9600:
                                     //Serial.begin(9600);
  // Start up the library:

  sensors.begin();
  //sensors.setWaitForConversion(false);
  // Locate the devices on the bus:
  Serial.print("Locating One Wire Temp Sensors...");
  Serial.print("Found ");
  deviceCount = sensors.getDeviceCount();
  Serial.print(deviceCount);
  Serial.println(" devices");
  

//End1W

//RTC

    Serial.print("compiled: ");
    Serial.print(__DATE__);
    Serial.println(__TIME__);    
    Rtc.Begin();
    RtcDateTime compiled = RtcDateTime(__DATE__, __TIME__);
    printDateTime(compiled);
//    Serial.println();
//    Rtc.SetDateTime(compiled);
    if (!Rtc.IsDateTimeValid()) 
    {
        Serial.println("RTC lost confidence in the DateTime!");
     //   Rtc.SetDateTime(compiled);
    }
    if (Rtc.GetIsWriteProtected())
    {
        Serial.println("RTC was write protected, enabling writing now");
        Rtc.SetIsWriteProtected(false);
    }
    if (!Rtc.GetIsRunning())
    {
        Serial.println("RTC was not actively running, starting now");
        Rtc.SetIsRunning(true);
    }
    RtcDateTime now = Rtc.GetDateTime();
    if (now < compiled) 
    {
        Serial.println("RTC is older than compile time!  (Updating DateTime)");
      //  Rtc.SetDateTime(compiled);
    }

//END RTC

}
void loop(){

////////Prefetch/ Preinitialize
//1 wire Fetch Temp Data Early 
 sensors.requestTemperatures();
// I wire EndFetch 


//OLED 
  u8g2.setFont(u8g2_font_ncenB08_tr);
  u8g2.setBusClock(500000);
//END OLED

 
//TP
//{
    Serial.print("CabinTemp = ");
    Serial.print(bmp.readTemperature());
    Serial.println(" *C");
//    CT==bmp.readTemperature();
    //Serial.print("Pressure = ");
    //Serial.print(bmp.readPressure());
    //Serial.println(" Pa");

    Serial.print("Altitude = ");
    Serial.print(bmp.readAltitude());
    Serial.println(" meters");

    //Serial.print("Pressure at sealevel (calculated) = ");
    //Serial.print(bmp.readSealevelPressure());
    //Serial.println(" Pa");

    Serial.print("Real altitude = ");
    Serial.print(bmp.readAltitude(seaLevelPressure_hPa * 100));
    Serial.println(" meters");
    
//    Serial.println();
//    delay(500);
//}

//EndTP

//TC6675
  // basic readout test, just print the current temp
  
   Serial.print("EGT = "); 
   Serial.println(thermocouple.readCelsius()-8);
   //Serial.print("F = ");
   //Serial.println(thermocouple.readFahrenheit());
    // For the MAX6675 to update, you must delay AT LEAST 250ms between reads!
//   delay(1000);
 
 
 //ENDTC6675

//Pressure Sensors Run
  oilPressure = analogRead(oilPressureInput); //reads value from input pin and assigns to variable
  boostPressure = analogRead(boostPressureInput); //reads value from input pin and assigns to variable
  oilPressureValue = ((oilPressure-pressureZero)*pressuretransducermaxPSI)/(pressureMax-pressureZero); //conversion equation to convert analog reading to psi
  boostPressureValue = ((boostPressure-pressureZero)*pressuretransducermaxPSI)/(pressureMax-pressureZero); //conversion equation to convert analog reading to psi
//End Pressure Sensors


//RTC RUN
    RtcDateTime now = Rtc.GetDateTime();
    printDateTime(now);
    printShortDateTime(now);
    if (!now.IsValid())
    {
        // Common Causes:
        //    1) the battery on the device is low or even missing and the power line was disconnected
        Serial.println("RTC lost confidence in the DateTime!");
    }
//END RTC RUN

// Battery Voltage Sensors run
  // Read the Analog Input
     adc_value1 = analogRead(BAT1_ANALOG_PIN);
    adc_value2 = analogRead(BAT2_ANALOG_PIN);
  // Determine voltage at ADC input
    adc_voltage1  = (adc_value1 * ref_voltage) / 1024.0; 
    adc_voltage2  = (adc_value2 * ref_voltage) / 1024.0; 
  // Calculate voltage at divider input
    in_voltage1 = adc_voltage1 / (R2/(R1+R2)) ; 
    in_voltage2 = adc_voltage2 / (R2/(R1+R2)) ; 
  // Print results to Serial Monitor to 2 decimal places
    Serial.print("BAT1 Voltage = ");
    Serial.println(in_voltage1, 2);
    Serial.print("BAT2 Voltage = ");
    Serial.println(in_voltage2, 2);
// End Battery Voltage Sensors


//1W and BOOST
  Serial.print("IMT: "); //Intake Manifold Air Temp
  printTemperature(sensor6);
  Serial.print("Spare: ");  //Coolant Team
  printTemperature(sensor3);
  Serial.print("TCT: "); //Transfer Case Temp
  printTemperature(sensor2);
  Serial.print("GBT: "); //Gearbox Temp
  printTemperature(sensor4);
  Serial.print("HT: "); //Cylinder Head Temp
  printTemperature(sensor5);
  Serial.print("Spare: ");
  printTemperature(sensor6);
  Serial.print("CT: ");
  printTemperature(sensor7);
  Serial.print(oilPressureValue, 1); //prints value from previous line to serial
  Serial.println("psi - Oil"); //prints label to serial
  Serial.print(boostPressureValue, 1); //prints value from previous line to serial
  Serial.println("psi - Boost"); //prints label to serial
  Serial.println();
//END 1W and BOOST


//TO SEND TO ESP32 via Serial 2
    Serial2.println("<");
  //  Serial2.print("DATETIME: ");
  //     printDateTime2(now);
    //Serial2.print("TIME: ");
  //   printTime2(now);
    Serial2.print("CTMP: ");
    Serial2.println(bmp.readTemperature());
//    Serial2.println("*C");
//    CT==bmp.readTemperature();
    //Serial.print("Pressure = ");
    //Serial.print(bmp.readPressure());
    //Serial.println(" Pa");
     Serial2.print("ALT: ");
     Serial2.println(bmp.readAltitude());
//    Serial2.println("m");
    //Serial.print("Pressure at sealevel (calculated) = ");
    //Serial.print(bmp.readSealevelPressure());
    //Serial.println(" Pa");
    Serial2.print("RALT: ");
    Serial2.println(bmp.readAltitude(seaLevelPressure_hPa * 100));
    //Serial2.println(" m");
    Serial2.print("BAT1: ");
    Serial2.println(in_voltage1, 2);
    Serial2.print("Oil: "); //prints label to serial
    Serial2.println(oilPressureValue, 1); //prints value from previous line to serial
    Serial2.print("BST: "); //prints label to serial
    Serial2.println(boostPressureValue, 1); //prints value from previous line to serial
 //   Serial2.print("BAT2 Voltage = ");
//    Serial2.println(in_voltage2, 2); 
    Serial2.print("EGT: "); 
    Serial2.println(thermocouple.readCelsius()-8);
    Serial2.print("CT: ");
    printTemperature2(sensor7);
    Serial2.print("IMT: "); //Intake Manifold Air Temp
    printTemperature2(sensor6);
   // Serial2.print("Spare1: ");  //Coolant Team
   // printTemperature2(sensor3);
    Serial2.print("TCT: "); //Transfer Case Temp
    printTemperature2(sensor2);
    Serial2.print("GBT: "); //Gearbox Temp
    printTemperature2(sensor4);
//    Serial2.print("HT: "); //Cylinder Head Temp
//    printTemperature2(sensor5);
//    Serial2.print("Spare2: ");
//    printTemperature2(sensor6);
    Serial2.println(">");
//END TO SEND TO ESP32 via Serial 2
    

//OLED
///////////// u8g2.setFont(u8g2_font_ncenB08_tr);
// u8g2.setFont(u8g2_font_8x13B_tf); 
u8g2.firstPage();
  do {
    //Row 1 Quick Snapshot View of Cabin Metrics and voltages
    u8g2.setCursor(0, 10); 
         u8g2.print(bmp.readTemperature(),0);
      u8g2.print("c");       
      u8g2.setCursor(18, 10); 
    u8g2.print(bmp.readAltitude(),0);
       u8g2.print("m"); 

       u8g2.setCursor(53, 10); 
    u8g2.print(in_voltage1, 1); 
           u8g2.print("v");  
        u8g2.print(F(" "));
        printShortDateTime(now);
//    u8g2.print( printShortDateTime(now));              
 //          u8g2.print("v");    

    //Row 2 Quick Snapshot View of Temps and Pressure
       u8g2.setCursor(0, 30); 
               u8g2.print("I: ");       
       displayTemperature(sensor6);
                u8g2.print("c");
       u8g2.setCursor(36, 30); 
               u8g2.print("C: ");
       displayTemperature(sensor7);
          u8g2.print("c");
            u8g2.setCursor(73, 30);          
               u8g2.print("T: ");       
       displayTemperature(sensor2);
          u8g2.print("c");
       displayTemperature(sensor4);
          u8g2.print("c");
          

               //Gearbox and T-Case Thresholds
                           if (sensors.getTempC(sensor2) > warningThreshTrans){
                          flash();
                          Serial.print("GB Temp > warning thresh: Thresh:"); Serial.print(warningThreshTrans);Serial.print("  Current:  "); printTemperature(sensor2); Serial.println();
                      }
                          if (sensors.getTempC(sensor2) > upperThreshTrans){
                          buzz();
                          Serial.print("GB Temp > high thresh: Thresh: "); Serial.print(upperThreshTrans); Serial.print("  Current:  "); printTemperature(sensor2); Serial.println();
                      }
                                if (sensors.getTempC(sensor4) > warningThreshTrans){
                          flash();
                          Serial.print("T-Case Temp > warning thresh: Thresh: " ); Serial.print(warningThreshTrans); Serial.print("  Current:  "); printTemperature(sensor4); Serial.println();
                      }
                          if (sensors.getTempC(sensor4) > upperThreshTrans){
                          buzz();
                          Serial.print("T-Case Temp > high thresh: Thresh: " ); Serial.print(upperThreshTrans); Serial.print("  Current:  "); printTemperature(sensor4); Serial.println();
                      }
              //END Gearbox and T-Case Thresholds


//Gauges from Row3
      u8g2.setCursor(0, 50); 
      u8g2.print(F("EGT "));
      u8g2.drawFrame(25,37,100,13); 
      u8g2.setCursor(40, 47); u8g2.print(F("|"));    //Lower
      u8g2.setCursor(86, 47); u8g2.print(F("|")); //Upper
      u8g2.setCursor(((thermocouple.readCelsius()*multiplierEGT)-baselineEGT),48);
      u8g2.print('I');
      u8g2.setCursor(107,50);
      //if (thermocouple.readCelsius() > 10)
      u8g2.print(thermocouple.readCelsius(),0);

              //EGT Thresholds 
                          if (thermocouple.readCelsius() > warningThreshEGT){
                            flash();
                            Serial.print("EGT Temp > warning thresh: Thresh: "); Serial.print(warningThreshEGT); Serial.print("  Current: "); Serial.println(thermocouple.readCelsius()); Serial.println();
                          }
                          if (thermocouple.readCelsius() > upperThreshEGT){
                            buzz();
                            Serial.print("EGT Temp > high thresh: Thresh: "); Serial.print(upperThreshEGT); Serial.print("  Current: "); Serial.println(thermocouple.readCelsius()); Serial.println();
                          }
              //END EGT Thresholds 
     
      u8g2.setCursor(0, 70); 
      u8g2.print(F("BST"));
      u8g2.drawFrame(25,57,100,13); 
      u8g2.setCursor(44, 67); u8g2.print(F("|"));    //Lower
      u8g2.setCursor(90, 67); u8g2.print(F("|")); //Upper
      u8g2.setCursor(107,70);    
      u8g2.print(boostPressureValue,0);
      u8g2.setCursor(((boostPressureValue*multiplierBST)-baselineBST),68);
      u8g2.print('I');
      
              //Boost Thresholds

                            if (boostPressureValue > warningThreshBST) {
                              flash();
                              Serial.print("BST > warning thresh: Thresh: "); Serial.print(warningThreshBST); Serial.print("  Current: "); Serial.print(boostPressureValue);  Serial.println();    
                            }
                           
                            if (boostPressureValue > upperThreshBST) {
                              buzz();
                              Serial.print("BST > high thresh: Thresh: "); Serial.print(upperThreshBST); Serial.print("  Current: "); Serial.print(boostPressureValue);   Serial.println();   
                            }

               //END Boost Thresholds

       u8g2.setCursor(0, 90); 
       u8g2.print(F("CT"));
       u8g2.drawFrame(25,77,100,13); 

      //u8g2.setCursor(105, 78); 
      // displayTemperature(sensor2) ;
        u8g2.setCursor(52, 87); u8g2.print(F("|"));    //Lower
        u8g2.setCursor(88, 87); u8g2.print(F("|")); //Upper
        u8g2.setCursor(((sensors.getTempC(sensor7)*multiplierCT)-baselineCT),88);
        u8g2.print('I');
        u8g2.setCursor(107,90);
          displayTemperature(sensor7) ;

                //Coolant Temp Thresholds
    
                                if (sensors.getTempC(sensor7) > warningThreshCT or sensors.getTempC(sensor7) < lowerThreshCT ){
                                    flash();
                                    Serial.print("CT > warrning thre or < low thresh: Lower Thresh: "); Serial.print(lowerThreshCT); Serial.print("  Warning Thresh: "); Serial.print(warningThreshCT); Serial.print("  Current: "); printTemperature(sensor7); Serial.println();
                                }
                              
                                if (sensors.getTempC(sensor7) > upperThreshCT){
                                    buzz();
                                    Serial.print("CT > high thresh: Thresh: "); Serial.print(upperThreshCT); Serial.print("  Current: "); printTemperature(sensor7); Serial.println();
                                }
                    //END Coolant Temp Thresholds

      
        u8g2.setCursor(0, 110); 
        u8g2.print("OIL");  
        u8g2.drawFrame(25,97,100,13);      
        //        u8g2.print(F("80psi"));
        u8g2.setCursor(40, 107); u8g2.print(F("|"));    //Lower
        u8g2.setCursor(95, 107); u8g2.print(F("|")); //Upper
        u8g2.setCursor(((oilPressureValue*multiplierOP)-baselineOP),108);
         if (oilPressureValue <75)     
        u8g2.print('I');    
        u8g2.setCursor(107,110);
        u8g2.print(oilPressureValue,0);
  } while ( u8g2.nextPage() );
///  delay(100);
  //ENDOLED  
}


void printTemperature(DeviceAddress deviceAddress)
{
  float tempC = sensors.getTempC(deviceAddress);
  Serial.print(tempC);  
  //Serial.print((char)176);
  Serial.println("C");
//  Serial.println(DallasTemperature::toFahrenheit(tempC));
}


void printTemperature2(DeviceAddress deviceAddress)
{
  float tempC = sensors.getTempC(deviceAddress);
  Serial2.println(tempC);  
  //Serial.print((char)176);
//  Serial2.println("C");
//  Serial.println(DallasTemperature::toFahrenheit(tempC));
}


void displayTemperature(DeviceAddress deviceAddress)
{
  float tempC = sensors.getTempC(deviceAddress);
   u8g2.print(tempC,0);
  
  //Serial.print((char)176);
//  Serial.println(DallasTemperature::toFahrenheit(tempC));
}


void flash()
{
     analogWrite(led,150) ;
     delay (20); 
     analogWrite(led,50); 
}


void buzz()
{
     analogWrite(buzzer,150) ;
     delay (10); 
     analogWrite(buzzer,50) ;

}

void draw()
{
   u8g2.firstPage();
  do
  {
    u8g2.drawXBMP( 0, 0, u8g_logo_width, u8g_logo_height, frame00); 
  }  while ( u8g2.nextPage() );
 
      delay(2000);
      u8g2.clearBuffer();
      u8g2.clear();
      u8g2.firstPage();
    do
  {

    u8g2.drawXBMP( 0, 0, u8g_logo_width, u8g_logo_height, frame01);    
   } while ( u8g2.nextPage() ); 
delay(2000); 
}
//OLED

// RTC Print
void printDateTime(const RtcDateTime& dt)
{
    char datestring[20];
    snprintf_P(datestring, 
            countof(datestring),
            PSTR("%02u/%02u/%04u %02u:%02u:%02u"),
            dt.Month(),
            dt.Day(),
            dt.Year(),
            dt.Hour(),
            dt.Minute(),
            dt.Second() );
    Serial.println(datestring);
}

// RTC Print
void printDateTime2(const RtcDateTime& dt)
{
    char datestring[20];
    snprintf_P(datestring, 
            countof(datestring),
            PSTR("%02u/%02u/%04u %02u:%02u:%02u"),
            dt.Month(),
            dt.Day(),
            dt.Year(),
            dt.Hour(),
            dt.Minute(),
            dt.Second() );
    Serial2.println(datestring);
}



/*
void printDate2(const RtcDateTime& dt)
{
    char datestring[11];
    snprintf_P(datestring, 
            countof(datestring),
            PSTR("%04u/%02u/%02u"),
            dt.Year(),
            dt.Month(),
            dt.Day());
    Serial2.print(datestring);
}

void printTime2(const RtcDateTime& dt)
{
    char datestring[9];
    snprintf_P(datestring, 
            countof(datestring),
            PSTR("%02u:%02u:%02u"),
            dt.Hour(),
            dt.Minute(),
            dt.Second() );
    Serial2.print(datestring);
}
*/
void printShortDateTime(const RtcDateTime& dt)
{
    char datestring[11];
    snprintf_P(datestring, 
            countof(datestring),
            PSTR("%02u %02u:%02u"),
            dt.Day(),
            dt.Hour(),
            dt.Minute());
    Serial.println(datestring);
    u8g2.print(datestring);
}
//END RTC Print
